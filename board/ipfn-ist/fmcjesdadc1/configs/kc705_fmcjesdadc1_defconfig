## board/ipfn-ist/fmcjesdadc1/configs/kc705_fmcjesdadc1_defconfig
```kconfig
BR2_microblazeel=y
BR2_CCACHE=y
BR2_KERNEL_HEADERS_4_9=y
BR2_TARGET_GENERIC_ROOT_PASSWD="analog"
BR2_TARGET_GENERIC_GETTY_PORT="ttyUL0"
BR2_TARGET_GENERIC_GETTY_BAUDRATE_115200=y
BR2_SYSTEM_DHCP="eth0"
BR2_TARGET_TZ_INFO=y
BR2_ROOTFS_POST_BUILD_SCRIPT="./board/ipfn-ist/fmcjesdadc1/post-build.sh"
BR2_PACKAGE_BZIP2=y
BR2_PACKAGE_ZIP=y
BR2_PACKAGE_STRACE=y
BR2_PACKAGE_MAKE=y
BR2_PACKAGE_SUBVERSION=y
BR2_PACKAGE_DBUS=y
BR2_PACKAGE_SPI_TOOLS=y
BR2_PACKAGE_MICROPYTHON=y
BR2_PACKAGE_MICROPYTHON_LIB=y
BR2_PACKAGE_OPENSSL=y
BR2_PACKAGE_LIBGPIOD=y
BR2_PACKAGE_LIBGPIOD_TOOLS=y
BR2_PACKAGE_LIBIIO=y
BR2_PACKAGE_LIBIIO_TESTS=y
BR2_PACKAGE_PAHO_MQTT_C=y
BR2_PACKAGE_FFTW=y
BR2_PACKAGE_LIBICONV=y
BR2_PACKAGE_READLINE=y
BR2_PACKAGE_DROPBEAR=y
BR2_PACKAGE_DROPBEAR_DISABLE_REVERSEDNS=y
# BR2_PACKAGE_DROPBEAR_SMALL is not set
BR2_PACKAGE_DROPBEAR_LASTLOG=y
BR2_PACKAGE_NTP=y
BR2_PACKAGE_NTP_NTPDATE=y
BR2_PACKAGE_NTP_NTPQ=y
BR2_PACKAGE_FILE=y
BR2_PACKAGE_SCREEN=y
BR2_PACKAGE_SUDO=y
BR2_PACKAGE_HTOP=y
BR2_PACKAGE_UTIL_LINUX=y
BR2_PACKAGE_JOE=y
BR2_TARGET_ROOTFS_CPIO=y
BR2_TARGET_ROOTFS_CPIO_GZIP=y
# BR2_TARGET_ROOTFS_TAR is not set
BR2_PACKAGE_HOST_UBOOT_TOOLS=y
```

## package/ipfn-ist/ad9250-iio-daq/Config.in
```kconfig
config BR2_PACKAGE_AD9250_IIO_DAQ
    bool "ad9250_iio_daq"
    help
        Data Acquisition on FMCJESDADC1 board.

        https://github.com/bernardocarvalho/buildroot
```
